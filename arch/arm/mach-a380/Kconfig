## arch/arm/mach-a380/Kconfig
```kconfig
if ARCH_A380

config SPL_FAT_SUPPORT
  bool
	default y

config SPL_LIBCOMMON_SUPPORT
	default y

config SPL_LIBDISK_SUPPORT
	default y

config SPL_LIBGENERIC_SUPPORT
	default y

config SPL_SERIAL_SUPPORT
	default y

config SYS_BOARD
	default "a380"

config BOARD_A380
	bool
	default y

config SYS_VENDOR
    string "Vendor name"
    default "faraday"

config SYS_SOC
    default "a380"

config SYS_CONFIG_NAME
	string "Board configuration name"
	default "farday-common"
	help
	This option contains information about board configuration name.
	Based on this option include/configs/<CONFIG_SYS_CONFIG_NAME>.h header
	will be used for board configuration.

config SYS_MALLOC_F_LEN
	default 0x600

config BOOT_INIT_FILE
	string "boot.bin init register filename"
	default ""
	help
	Add register writes to boot.bin format (max 256 pairs).
	Expect a table of register-value pairs, e.g. "0x12345678 0x4321"

choice 
	prompt "CPU Select"

config SOC_CA9
	bool "ARM CA9"
	select CPU_V7A

config SOC_FA626
	bool "Faraday FA626"
	select CPU_FA626

endchoice

config FARADAY
	bool
	default y

endif
```

## arch/arm/mach-echonous/Kconfig
```kconfig
if MACH_ECHONOUS

config SPL_FAT_SUPPORT
	default y

config SPL_LIBCOMMON_SUPPORT
	default y

config SPL_LIBDISK_SUPPORT
	default y

config SPL_LIBGENERIC_SUPPORT
	default y

config SPL_SERIAL_SUPPORT
	default y

config SYS_BOARD
	default "echonous"

config BOARD_ECHONOUS
	bool
	default y

config SYS_VENDOR
    string "Vendor name"
    default "faraday"

config SYS_SOC
    default "echonous"

config SYS_CONFIG_NAME
	string "Board configuration name"
	default "farday-common"
	help
	This option contains information about board configuration name.
	Based on this option include/configs/<CONFIG_SYS_CONFIG_NAME>.h header
	will be used for board configuration.

config SYS_MALLOC_F_LEN
	default 0x600

config BOOT_INIT_FILE
	string "boot.bin init register filename"
	default ""
	help
	Add register writes to boot.bin format (max 256 pairs).
	Expect a table of register-value pairs, e.g. "0x12345678 0x4321"

config CPU_ARM946ES
	bool
	default y

config FARADAY
	bool
	default y

endif
```

## arch/arm/mach-leo/Kconfig
```kconfig
if ARCH_LEO

config SPL_FAT_SUPPORT
	default y

config SPL_LIBCOMMON_SUPPORT
	default y

config SPL_LIBDISK_SUPPORT
	default y

config SPL_LIBGENERIC_SUPPORT
	default y

config SPL_SERIAL_SUPPORT
	default y

config SYS_BOARD
	default "leo"

config BOARD_LEO
	bool
	default y

config SYS_VENDOR
    string "Vendor name"
    default "faraday"

config SYS_SOC
    default "leo"

config SUPPORT_NONSEC
    bool "Support nonsecure mode"
    select CPU_V7_HAS_NONSEC

config SMP_PEN_ADDR
    hex "SMP Pen address"
    default 0x28008214

config SMP_MAGIC
    hex "SMP MAGIC number"
    default 0x07010203 

config DEFAULT_NONSEC
    bool "Start in Non-secure Mode"
    default n

config SYS_CONFIG_NAME
	string "Board configuration name"
	default "farday-common"
	help
	This option contains information about board configuration name.
	Based on this option include/configs/<CONFIG_SYS_CONFIG_NAME>.h header
	will be used for board configuration.

config SYS_MALLOC_F_LEN
	default 0x600

config BOOT_INIT_FILE
	string "boot.bin init register filename"
	default ""
	help
	Add register writes to boot.bin format (max 256 pairs).
	Expect a table of register-value pairs, e.g. "0x12345678 0x4321"

config FARADAY
	bool
	default y

endif
```

## board/faraday/a380/Kconfig
```kconfig
if ARCH_A380

config BSP_BOOTIMG_MAGIC_NUMBER
	hex
	default "0x11111111"
	
config DATAIMG_MAGIC_NUMBER
	hex
	default "0x33333333"
	
config LOOKUP_TABLE_MAGIC_NUMBER
	hex
	default 0x22222222
	
config NAND_BSP_LOOKUP_TABLE_BLOCK		
	hex
	default 4
	
config NAND_BSP_BLOCK
	hex
	default 6
	
config NAND_BSP_LOOKUP_TABLE_SCAN_NUM
	hex
	default 5
	
config SPL_BOOTIMG_MAGIC_NUMBER
	hex 			
	default 0x41333830
	
config SYS_BOARD
	default "a380"

config BOARD_A380_VP
	bool "Faraday A380 VP EVB"

config SYS_VENDOR
	default "faraday"

config SYS_SOC
	default "a380"

config SYS_CONFIG_NAME
	default "a380"

endif
```

## board/faraday/a500/Kconfig
```kconfig
if ARCH_A500

config SYS_BOARD
	default "a500"

config SYS_VENDOR
	default "faraday"

config SYS_SOC
	default "a500"

config SYS_CONFIG_NAME
	default "a500"

endif
```

## board/faraday/aladdin/Kconfig
```kconfig
if TARGET_ALADDIN

config SYS_BOARD
	default "aladdin"

config SYS_VENDOR
	default "faraday"

config SYS_SOC
	default "aladdin"

config SYS_CONFIG_NAME
	default "aladdin"

endif
```

## board/faraday/echonous/Kconfig
```kconfig
if TARGET_ECHONOUS

config SYS_BOARD
	default "echonous"

config SYS_VENDOR
	default "faraday"

config SYS_SOC
	default "echonous"

config SYS_CONFIG_NAME
	default "echonous"

endif
```

## board/faraday/hgu/Kconfig
```kconfig
if TARGET_HGU

config SYS_BOARD
	default "hgu"

config SYS_VENDOR
	default "faraday"

config SYS_SOC
	default "hgu"

config SYS_CONFIG_NAME
	default "hgu"

endif
```

## board/faraday/hgu10g/Kconfig
```kconfig
if MACH_HGU10G

config SYS_BOARD
	default "hgu10g"

config SYS_VENDOR
	default "faraday"

config SYS_SOC
	default "hgu10g"

config SYS_CONFIG_NAME
	default "hgu10g"

endif
```

## board/faraday/leo/Kconfig
```kconfig
if TARGET_VANGO

config SYS_BOARD
	default "vango"

config SYS_VENDOR
	default "faraday"

config SYS_SOC
	default "vango"

config SYS_CONFIG_NAME
	default "vango"

endif
```

## board/faraday/optichip/Kconfig
```kconfig
if TARGET_OPTICHIP

config SYS_BOARD
	default "optichip"

config SYS_VENDOR
	default "faraday"

config SYS_SOC
	default "optichip"

config SYS_CONFIG_NAME
	default "optichip"

endif
```

## board/faraday/ts711/Kconfig
```kconfig
if TARGET_TS711

config SYS_BOARD
	default "ts711"

config SYS_VENDOR
	default "faraday"

config SYS_SOC
	default "ts711"

config SYS_CONFIG_NAME
	default "ts711"

endif
```
